## CMakeLists.txt
```
set(BOARD nrf51_blenano)
set(KCONFIG_ROOT ${CMAKE_CURRENT_SOURCE_DIR}/Kconfig)

include($ENV{ZEPHYR_BASE}/cmake/app/boilerplate.cmake NO_POLICY_SCOPE)
project(NONE)

target_sources(app PRIVATE
  src/main.c
  src/bq769x0.c
  src/bms.c
  src/ble.c
  src/blinker.c
  src/utils.c
)
```

## Kconfig
```
mainmenu "BMS Configuration"

config ZEPHYR_BASE
    string
    option env="ZEPHYR_BASE"

source "$ZEPHYR_BASE/Kconfig.zephyr"

menu "BMS Settings"

config BMS_BOOT_DEVICE
       string
       prompt "Boot device"
       default "GPIO_0"
       help
         The GPIO device name to be used for the BMS boot port

config BMS_BOOT_PIN
       int
       prompt "Boot pin"
       default 21
       help
         Specify the GPIO pin number to be used for the BMS boot pin

config BMS_ALERT_DEVICE
       string
       prompt "Alert device"
       default "GPIO_0"
       help
         The GPIO device name to be used for the BMS alert port

config BMS_ALERT_PIN
       int
       prompt "Alert pin"
       default 22
       help
         The GPIO pin number to be used for the BMS alert pin

config BMS_I2C_DEVICE
       string
       prompt "I2C device"
       default "I2C_0"
       help
         The I2C device to be used for communicating with BQ769x0

config BMS_BLINK_DEVICE
       string
       prompt "Blink device"
       default "GPIO_0"
       help
         The GPIO device name to be used for LED blinker

config BMS_BLINK_PIN
       int
       prompt "Blink pin"
       default 18
       help
         The GPIO pin number to be used for the LED blinker

config BMS_OVP_ENABLE
       int
       prompt "OVP enable"
       default 3550
       help
         The minimum cell voltage (specified in mV) at which over-voltage protection is enabled

config BMS_OVP_DISABLE
       int
       prompt "OVP disable"
       default 3350
       help
         The maximum cell voltage (specified in mV) at which over-voltage protection is disabled.
         This only applies while OVP is enabled.

config BMS_UVP_ENABLE
       int
       prompt "UVP enable"
       default 3000
       help
         The maximum cell voltage (specified in mV) at which under-voltage proection is enabled

config BMS_UVP_DISABLE
       int
       prompt "UVP disable"
       default 3100
       help
         The minimum cell voltage (specified in mV) at which under-voltage protection is disabled.
         This only applies whiel UVP is enabled.

config BMS_SCD_DELAY
       int
       prompt "SCD delay"
       default 10000
       help
         Time to wait (specified in ms) before clearing short-circuit error

config BMS_OCD_DELAY
       int
       prompt "OCD delay"
       default 10000
       help
         Time to wait (specified in ms) before cleaning over-current discharge error

endmenu
```

## prj.conf
```kconfig
CONFIG_SYS_LOG=y
CONFIG_SYS_LOG_DEFAULT_LEVEL=3

CONFIG_SYS_CLOCK_TICKS_PER_SEC=1000

CONFIG_I2C=y
CONFIG_I2C_0=y
CONFIG_I2C_0_IRQ_PRI=2
CONFIG_I2C_NRF5=y
CONFIG_I2C_NRF5_GPIO_SCA_PIN=0
CONFIG_I2C_NRF5_GPIO_SCL_PIN=1

CONFIG_BT_PERIPHERAL=y
CONFIG_BT_DEVICE_NAME="BMS"
```

## src/main.c
```c
#include <gpio.h>
#include <misc/printk.h>
#include <logging/sys_log.h>
#include <zephyr.h>

#include "ble.h"
#include "blinker.h"
#include "bms.h"

#define STACKSIZE 1024
#define PRIORITY 5

typedef struct __attribute__((__packed__)) {
  uint8_t status;
  uint16_t voltages[BMS_NUM_CELLS];
  int16_t current;
  int32_t charge;
  uint8_t soc;
} bms_data_t;

static bms_data_t bms_data;

// bms thread

K_THREAD_STACK_DEFINE(bms_thread_stack_area, STACKSIZE);
static struct k_thread bms_thread_data;

void bms_thread(void *a, void *b, void *c) {
  while (1) {
    bms_update();
    k_sleep(200);
  }
}

// serial logger thread

K_THREAD_STACK_DEFINE(logger_thread_stack_area, STACKSIZE);
static struct k_thread logger_thread_data;

void logger_thread(void *a, void *b, void *c) {
  while (1) {
    bms_data.status = bms_status();
    bms_cell_voltages(bms_data.voltages);
    bms_data.current = bms_current();
    bms_data.charge = bms_charge();
    bms_data.soc = bms_soc();

    printk("mV=%d, %d, %d, %d\n", bms_data.voltages[0], bms_data.voltages[1], bms_data.voltages[2], bms_data.voltages[3]);
    printk("mA=%d\n", bms_data.current);
    printk("charge=%d\n", bms_data.charge);
    printk("soc=%d\n", bms_data.soc);

    ble_notify((uint8_t *) &bms_data, sizeof(bms_data));

    k_sleep(2000);
  }
}

// serial logger thread

K_THREAD_STACK_DEFINE(flasher_thread_stack_area, STACKSIZE);
static struct k_thread flasher_thread_data;

void flasher_thread(void *a, void *b, void *c) {
  while (1) {
    blinker_flash();
    k_sleep(30000);
  }
}

void main(void) {
  SYS_LOG_INF("starting...");

  ble_init();
  blinker_init(CONFIG_BMS_BLINK_DEVICE, CONFIG_BMS_BLINK_PIN);

  int rc = bms_init();
  if (rc < 0) {
    SYS_LOG_INF("failed to initialize BMS");
    return;
  }

  k_thread_create(
    &bms_thread_data, bms_thread_stack_area,
    K_THREAD_STACK_SIZEOF(bms_thread_stack_area),
    bms_thread,
    NULL, NULL, NULL,
    PRIORITY, 0, K_NO_WAIT);

  k_thread_create(
    &logger_thread_data, logger_thread_stack_area,
    K_THREAD_STACK_SIZEOF(logger_thread_stack_area),
    logger_thread,
    NULL, NULL, NULL,
    PRIORITY, 0, K_NO_WAIT);

  k_thread_create(
    &flasher_thread_data, flasher_thread_stack_area,
    K_THREAD_STACK_SIZEOF(flasher_thread_stack_area),
    flasher_thread,
    NULL, NULL, NULL,
    PRIORITY, 0, K_NO_WAIT);

  SYS_LOG_INF("started");
}

void _SysFatalErrorHandler(unsigned int reason, const NANO_ESF *pEsf) {
  blinker_on();
  while (1);
}
```

## src/ble.c
```c
#include <zephyr/types.h>
#include <stddef.h>
#include <string.h>
#include <errno.h>
#include <misc/byteorder.h>
#include <zephyr.h>
#include <logging/sys_log.h>

#include <bluetooth/bluetooth.h>
#include <bluetooth/hci.h>
#include <bluetooth/conn.h>
#include <bluetooth/uuid.h>
#include <bluetooth/gatt.h>

#include "ble.h"


// 8D9D7800-5B61-412A-AB71-5C7E0E559086
static struct bt_uuid_128 uuid_bms = BT_UUID_INIT_128(
  0x86, 0x90, 0x55, 0x0E, 0x7E, 0x5C, 0x71, 0xAB,
  0x2A, 0x41, 0x61, 0x5B, 0x00, 0x78, 0x9D, 0x8D);

// 8D9D7801-5B61-412A-AB71-5C7E0E559086
static struct bt_uuid_128 uuid_bms_values = BT_UUID_INIT_128(
  0x86, 0x90, 0x55, 0x0E, 0x7E, 0x5C, 0x71, 0xAB,
  0x2A, 0x41, 0x61, 0x5B, 0x01, 0x78, 0x9D, 0x8D);

static ssize_t ble_read_value(struct bt_conn *conn, const struct bt_gatt_attr *attr, void *buf, u16_t len, u16_t offset) {
  const uint8_t *value = attr->user_data;
  return bt_gatt_attr_read(conn, attr, buf, len, offset, value, sizeof(*value));
}

static struct bt_gatt_ccc_cfg ble_ccc_cfg[BT_GATT_CCC_MAX];

static void ble_ccc_cfg_changed(const struct bt_gatt_attr *attr, u16_t value) {
}

static struct bt_gatt_attr attrs_bms[] = {
  BT_GATT_PRIMARY_SERVICE(&uuid_bms),

  BT_GATT_CHARACTERISTIC(
    &uuid_bms_values.uuid,
    BT_GATT_CHRC_READ | BT_GATT_CHRC_NOTIFY),

  BT_GATT_DESCRIPTOR(
    &uuid_bms_values.uuid,
    BT_GATT_PERM_READ,
    ble_read_value,
    NULL,
    NULL),

  BT_GATT_CCC(ble_ccc_cfg, ble_ccc_cfg_changed),
};

static struct bt_gatt_service bms_svc = BT_GATT_SERVICE(attrs_bms);

static const struct bt_data ad[] = {
  BT_DATA_BYTES(BT_DATA_FLAGS, (BT_LE_AD_GENERAL | BT_LE_AD_NO_BREDR))
};

static const struct bt_data sd[] = {
  BT_DATA(BT_DATA_NAME_COMPLETE, CONFIG_BT_DEVICE_NAME, (sizeof(CONFIG_BT_DEVICE_NAME) - 1)),
};

static void ble_connected(struct bt_conn *conn, u8_t err) {
  if (err) {
    SYS_LOG_ERR("connection failed: %u", err);
  } else {
    SYS_LOG_INF("connected");
  }
}

static void ble_disconnected(struct bt_conn *conn, u8_t reason) {
  SYS_LOG_INF("disconnected: %u", reason);
}

static struct bt_conn_cb conn_callbacks = {
  .connected = ble_connected,
  .disconnected = ble_disconnected,
};

void ble_ready(int err) {
  if (err) {
    SYS_LOG_ERR("init failed: %d", err);
    return;
  }

  SYS_LOG_INF("initialized");

  bt_gatt_service_register(&bms_svc);

  err = bt_le_adv_start(BT_LE_ADV_CONN, ad, ARRAY_SIZE(ad), sd, ARRAY_SIZE(sd));
  if (err) {
    SYS_LOG_ERR("failed to start advertising: %d", err);
    return;
  }

  SYS_LOG_INF("advertising started");
}

void ble_init(void) {
  int err = bt_enable(ble_ready);

  if (err) {
    SYS_LOG_ERR("failed to enable: %d)", err);
    return;
  }

  bt_conn_cb_register(&conn_callbacks);
}

void ble_notify(uint8_t *data, int length) {
  bt_gatt_notify(NULL, &attrs_bms[2], data, length);
}
```

## src/ble.h
```c
#ifndef __BLE_H__
#define __BLE_H__

void ble_init(void);
void ble_notify(uint8_t *data, int length);

#endif
```

## src/blinker.c
```c
#include <gpio.h>
#include <logging/sys_log.h>

#include "blinker.h"

static struct device *gpio;
static int gpio_pin;

int blinker_init(char *device, int pin) {
  gpio_pin = pin;

  gpio = device_get_binding(device);

  if (gpio == NULL) {
    SYS_LOG_ERR("could not find %s", device);
    return -EINVAL;
  }

  gpio_pin_configure(gpio, gpio_pin, GPIO_DIR_OUT);

  return 0;
}

void blinker_on(void) {
  gpio_pin_write(gpio, gpio_pin, 1);
}

void blinker_off(void) {
  gpio_pin_write(gpio, gpio_pin, 0);
}

void blinker_flash(void) {
  blinker_on();
  k_sleep(100);
  blinker_off();
}
```

## src/blinker.h
```c
#ifndef __BLINKER_H__
#define __BLINKER_H__

int blinker_init(char *device, int pin);
void blinker_on(void);
void blinker_off(void);
void blinker_flash(void);

#endif
```

## src/bms.c
```c
#include <gpio.h>
#include <logging/sys_log.h>
#include <string.h>
#include <zephyr.h>

#include "bms.h"
#include "bq769x0.h"

static uint8_t status;
static uint8_t cells[BMS_NUM_CELLS] = { 0, 1, 2, 4, };
static uint16_t cell_voltages[BMS_NUM_CELLS];
static int16_t current; // most recent 250ms current average
static u64_t capacity = BMS_NOMINAL_CAPACITY;
static s64_t charge = -1; // cumulative mA seconds
static uint8_t ov = 0;
static uint8_t uv = 0;
static uint8_t scd = 0;
static s64_t scd_tick = 0;
static uint8_t ocd = 0;
static s64_t ocd_tick = 0;

void bms_handle_error(uint8_t status);
void bms_interpolate_charge(void);

static struct gpio_callback alert_cb;

static void bms_alert(struct device *gpiob, struct gpio_callback *cb, u32_t pins) {
  // TODO
}

int bms_init(void) {
  int rc;

  SYS_LOG_INF("initializing...");

  // setup alert interrupt
  struct device *gpio = device_get_binding(CONFIG_BMS_ALERT_DEVICE);
  if (gpio == NULL) {
    SYS_LOG_ERR("failed to get binding for %s", CONFIG_BMS_ALERT_DEVICE);
    return -EINVAL;
  }

  gpio_pin_configure(gpio, CONFIG_BMS_ALERT_PIN, GPIO_DIR_IN | GPIO_INT | GPIO_INT_EDGE | GPIO_INT_ACTIVE_HIGH | GPIO_PUD_PULL_DOWN);
  gpio_init_callback(&alert_cb, bms_alert, BIT(CONFIG_BMS_ALERT_PIN));
  gpio_add_callback(gpio, &alert_cb);
  gpio_pin_enable_callback(gpio, CONFIG_BMS_ALERT_PIN);

  rc = bq769x0_init(CONFIG_BMS_I2C_DEVICE);
  if (rc < 0) {
    SYS_LOG_ERR("failed to initialize BQ769x0");
    return rc;
  }

  rc = bq769x0_boot(CONFIG_BMS_BOOT_DEVICE, CONFIG_BMS_BOOT_PIN);
  if (rc < 0) {
    SYS_LOG_ERR("failed to boot BQ769x0");
    return rc;
  }

  bq769x0_config_t bq769x0_config;
  bq769x0_config.ovp = CONFIG_BMS_OVP_ENABLE;
  bq769x0_config.uvp = CONFIG_BMS_UVP_ENABLE;

  rc = bq769x0_configure(bq769x0_config);
  if (rc < 0) {
    SYS_LOG_ERR("failed to configure BQ769x0");
    return rc;
  }

  rc = bq769x0_balance_cell(-1);
  if (rc < 0) {
    return rc;
  }

  rc = bq769x0_enable_charging();
  if (rc < 0) {
    return rc;
  }

  rc = bq769x0_enable_discharging();
  if (rc < 0) {
    return rc;
  }

  SYS_LOG_INF("initialized");
  return 0;
}

// should be called at least every 250ms for accurate coulomb counting
int bms_update(void) {
  int rc;

  rc = bq769x0_read_status(&status);
  if (rc < 0) {
    return rc;
  }

  uint8_t error = bq769x0_status_error(status);
  if (error) {
    bms_handle_error(error);
  }

  for (int i = 0; i < BMS_NUM_CELLS; i++) {
    bq769x0_read_voltage(cells[i], &cell_voltages[i]);
  }

  if (charge == -1) {
    bms_interpolate_charge();
  }

  uint8_t cc_ready = bq769x0_cc_ready(status);
  if (cc_ready) {
    bq769x0_read_current(&current);
    charge += (current / 4); // CC updated every 250ms
  }

  if (scd) {
    if (k_uptime_get() - scd_tick > CONFIG_BMS_SCD_DELAY) {
      bq769x0_clear_status(BQ769X0_STATUS_SCD);
      bq769x0_enable_charging();
      bq769x0_enable_discharging();
    } else {
      return 0;
    }
  }

  if (ocd) {
    if (k_uptime_get() - ocd_tick > CONFIG_BMS_OCD_DELAY) {
      bq769x0_clear_status(BQ769X0_STATUS_OCD);
      bq769x0_enable_charging();
      bq769x0_enable_discharging();
    } else {
      return 0;
    }
  }

  if (ov) {
    // check to see if voltages have fallen enough to disable OVP
    uint8_t disable = 1;

    for (int i = 0; i < BMS_NUM_CELLS; i++) {
      disable = disable & (cell_voltages[i] <= CONFIG_BMS_OVP_DISABLE);
    }

    if (disable) {
      bq769x0_clear_status(BQ769X0_STATUS_OV);
      bq769x0_enable_charging();
    }
  }

  if (uv) {
    // check to see if voltages have risen enough to disable UVP
    uint8_t disable = 1;

    for (int i = 0; i < BMS_NUM_CELLS; i++) {
      disable = disable & (cell_voltages[i] >= CONFIG_BMS_UVP_DISABLE);
    }

    if (disable) {
      bq769x0_clear_status(BQ769X0_STATUS_UV);
      bq769x0_enable_discharging();
    }
  }

  return 0;
}

uint8_t bms_status() {
  return status & 0xF; // only include: UV | OV | SCD | OCD |
}

int bms_cell_voltages(uint16_t *voltages) {
  int len = sizeof(cell_voltages);
  memcpy(voltages, cell_voltages, len);
  return len;
}

int16_t bms_current(void) {
  return current;
}

int32_t bms_charge(void) {
  return charge;
}

uint8_t bms_soc(void) {
  return (capacity + charge) * 100 / capacity;
}

// helpers

void bms_handle_error(uint8_t status) {
  SYS_LOG_INF("error status: %d", status);

  if (status & 0b00000100) {
    // over voltage
    if (!ov) {
      SYS_LOG_ERR("over voltage limit");
      ov = 1;
      charge = 0;
    }
  } else {
    ov = 0;
  }

  if (status & 0b00001000) {
    // under voltage
    if (!uv) {
      SYS_LOG_ERR("under voltage limit");
      uv = 1;
      capacity = -charge;

      // TODO: persist updated capacity
    }

    // TODO: probably shut down the MCU here as well since it continues to draw current
  } else {
    uv = 0;
  }

  if (status & 0b00000010) {
    // short circuit
    if (!scd) {
      SYS_LOG_ERR("short circuit");
      scd_tick = k_uptime_get();
    }
    scd = 1;
  } else {
    scd = 0;
  }

  if (status & 0b00000001) {
    // overcurrent discharge
    if (!ocd) {
      SYS_LOG_ERR("overcurrent discharge");
      ocd_tick = k_uptime_get();
    }
    ocd = 1;
  } else {
    ocd = 0;
  }
}

void bms_interpolate_charge(void) {
  SYS_LOG_INF("interpolating charge");

  uint32_t average_cell_voltage = 0;
  for (int i = 0; i < BMS_NUM_CELLS; i++) {
    average_cell_voltage += cell_voltages[i];
  }

  average_cell_voltage /= BMS_NUM_CELLS;

  uint32_t mv_range = CONFIG_BMS_OVP_ENABLE - CONFIG_BMS_UVP_ENABLE;
  u64_t capacity_per_mv = BMS_NOMINAL_CAPACITY / mv_range;
  uint32_t mv_offset = CONFIG_BMS_OVP_ENABLE - average_cell_voltage;

  charge = -(capacity_per_mv * mv_offset);
}
```

## src/bms.h
```c
#ifndef __BMS_H__
#define __BMS_H__

#define BMS_NUM_CELLS 4
#define BMS_NOMINAL_CAPACITY 72000000 // mAs (20Ah)

int bms_init(void);
int bms_update(void);
uint8_t bms_status(void);
int bms_cell_voltages(uint16_t *voltages);
int16_t bms_current(void);
int32_t bms_charge(void);
uint8_t bms_soc(void);

#endif
```

## src/bq769x0.c
```c
#include <gpio.h>
#include <i2c.h>
#include <logging/sys_log.h>
#include <string.h>

#include "bq769x0.h"
#include "utils.h"

#define BQ769X0_ADDR 0x08
#define BQ769X0_CFG_VALUE 0x19

// registers

#define BQ769X0_REG_SYS_STAT 0x00
#define BQ769X0_REG_CELLBAL1 0x01
#define BQ769X0_REG_SYS_CTRL1 0x04
#define BQ769X0_REG_SYS_CTRL2 0x05
#define BQ769X0_REG_PROTECT1 0x06
#define BQ769X0_REG_PROTECT2 0x07
#define BQ769X0_REG_PROTECT3 0x08
#define BQ769X0_REG_OV_TRIP 0x09
#define BQ769X0_REG_UV_TRIP 0x0A
#define BQ769X0_REG_CFG 0x0B
#define BQ769X0_REG_VC1_HI 0x0C
#define BQ769X0_REG_BAT_HI 0x2A
#define BQ769X0_REG_BAT_LO 0x2B
#define BQ769X0_REG_CC_HI 0x32
#define BQ769X0_REG_CC_LO 0x33
#define BQ769X0_REG_ADCGAIN1 0x50
#define BQ769X0_REG_ADCOFFSET 0x51
#define BQ769X0_REG_ADCGAIN2 0x59

// bits

#define BQ769X0_REG_CTRL1_ADC_EN 4

#define BQ769X0_REG_STAT_OCD 0
#define BQ769X0_REG_STAT_SCD 1
#define BQ769X0_REG_STAT_OV 2
#define BQ769X0_REG_STAT_UV 3
#define BQ769X0_REG_STAT_OVRD_ALERT 4
#define BQ769X0_REG_STAT_DEVICE_XREADY 5
#define BQ769X0_REG_STAT_CC_READY 7

#define BQ769X0_REG_CTRL2_CHG_ON 0
#define BQ769X0_REG_CTRL2_DSG_ON 1
#define BQ769X0_REG_CTRL2_CC_ONESHOT 5
#define BQ769X0_REG_CTRL2_CC_EN 6
#define BQ769X0_REG_CTRL2_DELAY_DIS 7

#define BQ769X0_REG_PROTECT1_SCD_T 0
#define BQ769X0_REG_PROTECT1_SCD_D 3
#define BQ769X0_REG_PROTECT1_RSNS 7

#define BQ769X0_REG_PROTECT2_OCD_T 0
#define BQ769X0_REG_PROTECT2_OCD_D 4

#define BQ769X0_REG_PROTECT3_OV_D 4
#define BQ769X0_REG_PROTECT3_UV_D 6

static struct device *i2c;

static int8_t adc_offset;
static uint16_t adc_gain;

int bq769x0_reg_write_byte(uint8_t reg, uint8_t value);
int bq769x0_reg_read(uint8_t reg, uint8_t *buffer, size_t length);
int bq769x0_reg_read_byte(uint8_t reg, uint8_t *value);
int bq769x0_reg_update_byte(uint8_t reg, uint8_t mask, uint8_t value);

int bq769x0_init(char *i2c_device) {
  int rc;

  SYS_LOG_INF("initializing...");

  i2c = device_get_binding(i2c_device);

  if (i2c == NULL) {
    SYS_LOG_ERR("could not find %s", i2c_device);
    return -EINVAL;
  }

  static union dev_config i2c_cfg = {
    .raw = 0,
    .bits = {
      .use_10_bit_addr = 0,
      .is_master_device = 1,
      .speed = I2C_SPEED_STANDARD,
    },
  };

  rc = i2c_configure(i2c, i2c_cfg.raw);
  if (rc < 0) {
    SYS_LOG_ERR("could not configure I2C_0");
    return rc;
  }

  SYS_LOG_INF("initialized");
  return 0;
}

int bq769x0_boot(char *boot_device, int boot_pin) {
  SYS_LOG_INF("booting...");

  struct device *gpio = device_get_binding(boot_device);

  if (gpio == NULL) {
    SYS_LOG_ERR("could not find %s", boot_device);
    return -EINVAL;
  }

  gpio_pin_configure(gpio, boot_pin, GPIO_DIR_OUT);
  gpio_pin_write(gpio, boot_pin, 1);

  // datasheet says wait at least 2ms
  k_sleep(5);

  gpio_pin_configure(gpio, boot_pin, GPIO_DIR_IN);

  // datasheets says wait at least 10ms
  k_sleep(20);

  SYS_LOG_INF("booted");
  return 0;
}

int bq769x0_configure(bq769x0_config_t config) {
  SYS_LOG_INF("configuring...");

  int rc;

  // test I2C communication
  uint8_t cfg;

  rc = bq769x0_reg_write_byte(BQ769X0_REG_CFG, BQ769X0_CFG_VALUE);
  if (rc < 0) {
    SYS_LOG_ERR("failed to write CFG register");
    return rc;
  }

  rc = bq769x0_reg_read_byte(BQ769X0_REG_CFG, &cfg);
  if (rc < 0) {
    SYS_LOG_ERR("failed to read CFG register");
    return rc;
  }

  if (cfg != BQ769X0_CFG_VALUE) {
    SYS_LOG_ERR("invalid CFG value");
    return -EINVAL;
  }

  // enable ADC
  uint8_t adc_en = 1 << BQ769X0_REG_CTRL1_ADC_EN;
  rc = bq769x0_reg_update_byte(BQ769X0_REG_SYS_CTRL1, adc_en, adc_en);
  if (rc < 0) {
    SYS_LOG_ERR("failed to enable ADC");
    return rc;
  }

  // enable continous current monitoring
  uint8_t cc_en = 1 << BQ769X0_REG_CTRL2_CC_EN;
  rc = bq769x0_reg_update_byte(BQ769X0_REG_SYS_CTRL2, cc_en, cc_en);
  if (rc < 0) {
    SYS_LOG_ERR("failed to enable CC");
    return rc;
  }

  // read ADC offset
  rc = bq769x0_reg_read_byte(BQ769X0_REG_ADCOFFSET, &adc_offset);
  if (rc < 0) {
    SYS_LOG_ERR("failed to read ADCOFFSET");
    return rc;
  }

  // read ADC gain
  uint8_t adc_gain1;
  uint8_t adc_gain2;
  rc = bq769x0_reg_read_byte(BQ769X0_REG_ADCGAIN1, &adc_gain1);
  if (rc < 0) {
    SYS_LOG_ERR("failed to read ADCGAIN1");
    return rc;
  }
  rc = bq769x0_reg_read_byte(BQ769X0_REG_ADCGAIN2, &adc_gain2);
  if (rc < 0) {
    SYS_LOG_ERR("failed to read ADCGAIN2");
    return rc;
  }
  adc_gain = 365 + (((adc_gain1 & 0b00001100) << 1) | ((adc_gain2 & 0b11100000) >> 5));

  // clear all alerts
  rc = bq769x0_reg_write_byte(BQ769X0_REG_SYS_STAT, 0b10111111);
  if (rc < 0) {
    SYS_LOG_ERR("failed to clear alerts");
    return rc;
  }

  // set under-voltage protection
  uint8_t uvp = ((((config.uvp - adc_offset) * 1000 / adc_gain) >> 4) & 0xFF) + 1;
  rc = bq769x0_reg_write_byte(BQ769X0_REG_UV_TRIP, uvp);
  if (rc < 0) {
    SYS_LOG_ERR("failed to write UV_TRIP");
    return rc;
  }

  // set over-voltage protection
  uint8_t ovp = (((config.ovp - adc_offset) * 1000 / adc_gain) >> 4) & 0xFF;
  rc = bq769x0_reg_write_byte(BQ769X0_REG_OV_TRIP, ovp);
  if (rc < 0) {
    SYS_LOG_ERR("failed to write OV_TRIP");
    return rc;
  }

  // set short-circuit protection
  uint8_t protect1 = 0;
  protect1 |= (1 << BQ769X0_REG_PROTECT1_RSNS); // set RSNS = 1
  protect1 |= (0x2 << BQ769X0_REG_PROTECT1_SCD_D); // 200uS delay
  protect1 |= (0x7 << BQ769X0_REG_PROTECT1_SCD_T); // 200mV across 0.005ohm = 40A
  rc = bq769x0_reg_write_byte(BQ769X0_REG_PROTECT1, protect1);
  if (rc < 0) {
    SYS_LOG_ERR("failed to write PROTECT1");
    return rc;
  }

  // set over-current discharge protection
  uint8_t protect2 = 0;
  protect2 |= (0x0 << BQ769X0_REG_PROTECT2_OCD_D); // 8ms delay
  protect2 |= (0x6 << BQ769X0_REG_PROTECT2_OCD_T); // 50mV across 0.005ohm = 10A
  rc = bq769x0_reg_write_byte(BQ769X0_REG_PROTECT2, protect2);
  if (rc < 0) {
    SYS_LOG_ERR("failed to write PROTECT2");
    return rc;
  }

  // set uv and ov delay
  uint8_t protect3 = 0;
  protect3 |= (0x1 << BQ769X0_REG_PROTECT3_UV_D); // 4s
  protect3 |= (0x1 << BQ769X0_REG_PROTECT3_OV_D); // 2s
  rc = bq769x0_reg_write_byte(BQ769X0_REG_PROTECT3, protect3);
  if (rc < 0) {
    SYS_LOG_ERR("failed to write PROTECT3");
    return rc;
  }

  SYS_LOG_INF("configured");
  return 0;
}

int bq769x0_read_voltage(int cell, uint16_t *voltage) {
  int rc;

  uint8_t reg = BQ769X0_REG_VC1_HI + cell * 2;
  uint8_t buffer[2];

  // FIXME
  rc = bq769x0_reg_read(reg, buffer, 2);
  if (rc < 0) {
    SYS_LOG_ERR("failed to read cell %d voltage", cell);
    return rc;
  }

  uint16_t adc_value = ((buffer[0] & 0b00111111) << 8) | buffer[1];
  *voltage = adc_value * adc_gain / 1000 + adc_offset;

  return 0;
}

int bq769x0_read_current(int16_t *current) {
  int rc;

  // read CC
  uint8_t msb;
  uint8_t lsb;

  rc = bq769x0_reg_read_byte(BQ769X0_REG_CC_HI, &msb);
  if (rc < 0) {
    SYS_LOG_ERR("failed to read CC_HI");
    return rc;
  }

  rc = bq769x0_reg_read_byte(BQ769X0_REG_CC_LO, &lsb);
  if (rc < 0) {
    SYS_LOG_ERR("failed to read CC_LO");
    return rc;
  }

  uint16_t adc_value = (msb << 8) | lsb;
  *current = (int16_t) adc_value * 8.44 / 5.0;

  // clear CC_READY
  uint8_t cc_ready = 1 << BQ769X0_REG_STAT_CC_READY;
  rc = bq769x0_reg_write_byte(BQ769X0_REG_SYS_STAT, cc_ready);
  if (rc < 0) {
    SYS_LOG_ERR("failed to clear CC_READY");
    return rc;
  }

  return 0;
}

int bq769x0_read_status(uint8_t *status) {
  int rc;

  rc = bq769x0_reg_read_byte(BQ769X0_REG_SYS_STAT, status);
  if (rc < 0) {
    SYS_LOG_ERR("failed to read status");
    return rc;
  }

  return 0;
}

int bq769x0_clear_status(uint8_t bit) {
  int rc;

  uint8_t mask = 1 << bit;
  rc = bq769x0_reg_write_byte(BQ769X0_REG_SYS_STAT, mask);
  if (rc < 0) {
    SYS_LOG_ERR("failed to clear status: %d", mask);
    return rc;
  }

  return 0;
}

uint8_t bq769x0_status_error(uint8_t status) {
  // mask out CC_READY (not considered an error)
  return status & 0b01111111;
}

uint8_t bq769x0_cc_ready(uint8_t status) {
  return status & 0b10000000;
}

int bq769x0_enable_discharging(void) {
  int rc;

  uint8_t dsg_on = 1 << BQ769X0_REG_CTRL2_DSG_ON;
  rc = bq769x0_reg_update_byte(BQ769X0_REG_SYS_CTRL2, dsg_on, dsg_on);
  if (rc < 0) {
    SYS_LOG_ERR("failed to enable discharging");
    return rc;
  }

  return 0;
}

int bq769x0_enable_charging(void) {
  int rc;

  uint8_t chg_on = 1 << BQ769X0_REG_CTRL2_CHG_ON;
  rc = bq769x0_reg_update_byte(BQ769X0_REG_SYS_CTRL2, chg_on, chg_on);
  if (rc < 0) {
    SYS_LOG_ERR("failed to enable charging");
    return rc;
  }

  return 0;
}

int bq769x0_balance_cell(int8_t cell) {
  int rc;

  if (cell == -1) {
    rc = bq769x0_reg_write_byte(BQ769X0_REG_CELLBAL1, 0);
    if (rc < 0) {
      SYS_LOG_ERR("failed to disable cell balancing");
      return rc;
    }
  } else {
    rc = bq769x0_reg_write_byte(BQ769X0_REG_CELLBAL1, 1 << cell);
    if (rc < 0) {
      SYS_LOG_ERR("failed to enable cell balancing");
      return rc;
    }
  }

  return 0;
}

// helpers

int bq769x0_reg_write_byte(uint8_t reg, uint8_t value) {
  uint8_t data[3] = { (BQ769X0_ADDR << 1) | 0, reg, value };
  uint8_t crc = crc8(data, sizeof(data));

  uint8_t buffer[3] = { reg, value, crc };
  return i2c_write(i2c, buffer, sizeof(buffer), BQ769X0_ADDR);
}

int bq769x0_reg_read(uint8_t reg, uint8_t *buffer, size_t length) {
  uint8_t result[length * 2];

  int rc = i2c_burst_read(i2c, BQ769X0_ADDR, reg, result, length * 2);
  if (rc < 0) {
    SYS_LOG_ERR("failed to read register");
    return rc;
  }

  for (int i = 0; i < (length * 2); i += 2) {
    // TODO: check CRCs
    buffer[i / 2] = result[i];
  }

  return 0;
}

int bq769x0_reg_read_byte(uint8_t reg, uint8_t *value) {
  return bq769x0_reg_read(reg, value, 1);
}

int bq769x0_reg_update_byte(uint8_t reg, uint8_t mask, uint8_t value) {
  uint8_t old_value, new_value;

  int rc = bq769x0_reg_read_byte(reg, &old_value);
  if (rc != 0) {
    return rc;
  }

  new_value = (old_value & ~mask) | (value & mask);
  if (new_value == old_value) {
    return 0;
  }

  return bq769x0_reg_write_byte(reg, new_value);
}
```

## src/bq769x0.h
```c
#ifndef __BQ769X0_H__
#define __BQ769X0_H__

#define BQ769X0_STATUS_OCD 0
#define BQ769X0_STATUS_SCD 1
#define BQ769X0_STATUS_OV 2
#define BQ769X0_STATUS_UV 3

typedef struct {
  uint16_t uvp; // mV
  uint16_t ovp; // mV
} bq769x0_config_t;

int bq769x0_init(char *i2c_device);
int bq769x0_boot(char *boot_device, int boot_pin);
int bq769x0_configure(bq769x0_config_t config);
int bq769x0_read_voltage(int cell_n, uint16_t *voltage);
int bq769x0_read_current(int16_t *current);
int bq769x0_read_status(uint8_t *status);
int bq769x0_clear_status(uint8_t bit);
uint8_t bq769x0_status_error(uint8_t status);
uint8_t bq769x0_cc_ready(uint8_t status);
int bq769x0_enable_discharging(void);
int bq769x0_enable_charging(void);
int bq769x0_balance_cell(int8_t cell);

#endif
```

## src/utils.c
```c
#include "utils.h"

uint8_t crc8(const uint8_t *buffer, size_t length) {
  uint8_t crc = 0;

  for (int i = 0; i < length; i++) {
    uint8_t data = crc ^ buffer[i];

    for (int i = 0; i < 8; i++ ) {
      if (data & 0x80) {
        data <<= 1;
        data ^= 0x07;
      } else {
        data <<= 1;
      }
    }

    crc = data;
  }

  return crc;
}
```

## src/utils.h
```c
#ifndef __UTILS_H__
#define __UTILS_H__

#include <stddef.h>
#include <stdint.h>

uint8_t crc8(const uint8_t *buffer, size_t length);

#endif
```
